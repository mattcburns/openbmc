## meta-ibm/meta-romulus-prime/conf/layer.conf
```bitbake
# We have a conf and classes directory, add to BBPATH
BBPATH .= ":${LAYERDIR}"

# We have recipes-* directories, add to BBFILES
BBFILES += "${LAYERDIR}/recipes-*/*/*.bb \
            ${LAYERDIR}/recipes-*/*/*.bbappend"

BBFILE_COLLECTIONS += "romulus-prime-layer"
BBFILE_PATTERN_romulus-prime-layer := "^${LAYERDIR}/"
LAYERSERIES_COMPAT_romulus-layer = "warrior zeus dunfell"
```
